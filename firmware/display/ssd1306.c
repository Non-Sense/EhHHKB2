#include "ssd1306.h"

#include <string.h>

#include "hardware/i2c.h"
#include "pico/stdlib.h"

#define I2C_PORT i2c0
#define I2C_SDA_PIN 0
#define I2C_SCL_PIN 1
#define I2C_BAUDRATE 400000

#define SSD1306_CMD_DISPLAY_OFF 0xAE
#define SSD1306_CMD_DISPLAY_ON 0xAF
#define SSD1306_CMD_SET_CONTRAST 0x81
#define SSD1306_CMD_ENTIRE_DISPLAY_ON 0xA4
#define SSD1306_CMD_NORMAL_DISPLAY 0xA6
#define SSD1306_CMD_INVERT_DISPLAY 0xA7
#define SSD1306_CMD_SET_MUX_RATIO 0xA8
#define SSD1306_CMD_SET_DISPLAY_OFFSET 0xD3
#define SSD1306_CMD_SET_START_LINE 0x40
#define SSD1306_CMD_SET_SEGMENT_REMAP 0xA1
#define SSD1306_CMD_SET_COM_SCAN_DEC 0xC8
#define SSD1306_CMD_SET_COM_PINS 0xDA
#define SSD1306_CMD_SET_PRECHARGE 0xD9
#define SSD1306_CMD_SET_VCOMH_DESELECT 0xDB
#define SSD1306_CMD_SET_CHARGE_PUMP 0x8D
#define SSD1306_CMD_MEMORY_MODE 0x20
#define SSD1306_CMD_COLUMN_ADDR 0x21
#define SSD1306_CMD_PAGE_ADDR 0x22
#define SSD1306_CMD_DEACTIVATE_SCROLL 0x2E

uint8_t ssd1306_buffer[SSD1306_WIDTH * SSD1306_HEIGHT / 8];

static bool ssd1306_write_command(const uint8_t command) {
    const uint8_t buffer[2] = {0x00, command};  // Co=0, D/C#=0 (command)
    return i2c_write_blocking(I2C_PORT, SSD1306_I2C_ADDR, buffer, 2, false) ==
           2;
}

static bool ssd1306_write_data(const uint8_t* data, size_t len) {
    uint8_t buffer[256];

    while (len > 0) {
        const size_t chunk_size = (len > 127) ? 127 : len;

        buffer[0] = 0x40;  // Co=0, D/C#=1 (data)
        for (size_t i = 0; i < chunk_size; i++) {
            buffer[i + 1] = data[i];
        }

        if (i2c_write_blocking(I2C_PORT, SSD1306_I2C_ADDR, buffer,
                               chunk_size + 1,
                               false) != (int)(chunk_size + 1)) {
            return false;
        }

        data += chunk_size;
        len -= chunk_size;
    }

    return true;
}

void ssd1306_init(void) {
    i2c_init(I2C_PORT, I2C_BAUDRATE);

    gpio_set_function(I2C_SDA_PIN, GPIO_FUNC_I2C);
    gpio_set_function(I2C_SCL_PIN, GPIO_FUNC_I2C);
    gpio_pull_up(I2C_SDA_PIN);
    gpio_pull_up(I2C_SCL_PIN);

    sleep_ms(100);  // パネルの電源が立ち上がるのを待つ

    memset(ssd1306_buffer, 0, sizeof(ssd1306_buffer));

    ssd1306_write_command(SSD1306_CMD_DISPLAY_OFF);

    ssd1306_write_command(SSD1306_CMD_MEMORY_MODE);
    ssd1306_write_command(0x00);  // horizontal addressing mode

    ssd1306_write_command(SSD1306_CMD_SET_MUX_RATIO);
    ssd1306_write_command(SSD1306_HEIGHT - 1);

    ssd1306_write_command(SSD1306_CMD_SET_DISPLAY_OFFSET);
    ssd1306_write_command(0x00);

    ssd1306_write_command(SSD1306_CMD_SET_START_LINE | 0x00);

    // カラム 127 を SEG0 に、COM[N]→COM0 の順に走査（基板の実装向き）
    ssd1306_write_command(SSD1306_CMD_SET_SEGMENT_REMAP);
    ssd1306_write_command(SSD1306_CMD_SET_COM_SCAN_DEC);

    ssd1306_write_command(SSD1306_CMD_SET_COM_PINS);
#if SSD1306_HEIGHT == 32
    ssd1306_write_command(0x02);
#else
    ssd1306_write_command(0x12);
#endif

    ssd1306_write_command(SSD1306_CMD_SET_CONTRAST);
#if SSD1306_HEIGHT == 32
    ssd1306_write_command(0x8F);
#else
    ssd1306_write_command(0xCF);
#endif

    ssd1306_write_command(SSD1306_CMD_ENTIRE_DISPLAY_ON);
    ssd1306_write_command(SSD1306_CMD_NORMAL_DISPLAY);

    ssd1306_write_command(SSD1306_CMD_SET_PRECHARGE);
    ssd1306_write_command(0xF1);

    ssd1306_write_command(SSD1306_CMD_SET_VCOMH_DESELECT);
    ssd1306_write_command(0x40);

    ssd1306_write_command(SSD1306_CMD_SET_CHARGE_PUMP);
    ssd1306_write_command(0x14);  // チャージポンプ有効（表示に必須）

    ssd1306_write_command(SSD1306_CMD_DEACTIVATE_SCROLL);
    ssd1306_write_command(SSD1306_CMD_DISPLAY_ON);

    sleep_ms(10);  // 表示が安定するまで待つ
}

void ssd1306_clear_buffer(void) {
    memset(ssd1306_buffer, 0, sizeof(ssd1306_buffer));
}

void ssd1306_display(void) {
    ssd1306_write_command(SSD1306_CMD_COLUMN_ADDR);
    ssd1306_write_command(0);
    ssd1306_write_command(SSD1306_WIDTH - 1);

    ssd1306_write_command(SSD1306_CMD_PAGE_ADDR);
    ssd1306_write_command(0);
    ssd1306_write_command((SSD1306_HEIGHT / 8) - 1);

    ssd1306_write_data(ssd1306_buffer, sizeof(ssd1306_buffer));
}

void ssd1306_set_pixel(const uint8_t x, const uint8_t y, const bool on) {
    if (x >= SSD1306_WIDTH || y >= SSD1306_HEIGHT) {
        return;
    }

    const uint16_t index = x + (y / 8) * SSD1306_WIDTH;
    if (on) {
        ssd1306_buffer[index] |= (1 << (y % 8));
    } else {
        ssd1306_buffer[index] &= ~(1 << (y % 8));
    }
}

bool ssd1306_get_pixel(const uint8_t x, const uint8_t y) {
    if (x >= SSD1306_WIDTH || y >= SSD1306_HEIGHT) {
        return false;
    }

    const uint16_t index = x + (y / 8) * SSD1306_WIDTH;
    return (ssd1306_buffer[index] & (1 << (y % 8))) != 0;
}

void ssd1306_draw_hline(const uint8_t x0, const uint8_t y, const uint8_t width,
                        const bool on) {
    for (uint8_t x = x0; x < x0 + width && x < SSD1306_WIDTH; x++) {
        ssd1306_set_pixel(x, y, on);
    }
}

void ssd1306_draw_vline(const uint8_t x, const uint8_t y0, const uint8_t height,
                        const bool on) {
    for (uint8_t y = y0; y < y0 + height && y < SSD1306_HEIGHT; y++) {
        ssd1306_set_pixel(x, y, on);
    }
}

void ssd1306_invert(const bool invert) {
    ssd1306_write_command(invert ? SSD1306_CMD_INVERT_DISPLAY
                                 : SSD1306_CMD_NORMAL_DISPLAY);
}

void ssd1306_set_contrast(const uint8_t contrast) {
    ssd1306_write_command(SSD1306_CMD_SET_CONTRAST);
    ssd1306_write_command(contrast);
}

void ssd1306_power_on(const bool on) {
    ssd1306_write_command(on ? SSD1306_CMD_DISPLAY_ON
                             : SSD1306_CMD_DISPLAY_OFF);
}

// 6x8 フォント（5x7 + 1 ピクセルの字間）。1 文字 = 1 列 1 バイト × 6。
const uint8_t font_data[FONT_CHAR_COUNT][FONT_WIDTH] = {
    {0x00, 0x00, 0x00, 0x00, 0x00, 0x00},  // ' ' (0x20)
    {0x00, 0x00, 0x5F, 0x00, 0x00, 0x00},  // '!' (0x21)
    {0x00, 0x07, 0x00, 0x07, 0x00, 0x00},  // '"' (0x22)
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    {0x0C, 0x62, 0x7F, 0x62, 0x0C, 0x00},  // 0x86: USB（トライデント）
};

void ssd1306_draw_char(const uint8_t x, const uint8_t y, const char ch,
                       const bool on) {
    const unsigned char uch = (unsigned char)ch;
    if (uch < FONT_FIRST_CHAR || uch > FONT_LAST_CHAR) {
        return;
    }

    const uint8_t char_index = uch - FONT_FIRST_CHAR;
    const uint8_t* char_data = font_data[char_index];

    for (uint8_t col = 0; col < FONT_WIDTH; col++) {
        const uint8_t pixel_data = char_data[col];
        for (uint8_t bit = 0; bit < 8; bit++) {
            if (x + col >= SSD1306_WIDTH) {
                return;
            }
            bool pixel_on = (pixel_data & (1 << bit)) != 0;
            ssd1306_set_pixel(x + col, y + bit, on && pixel_on);
        }
    }
}

void ssd1306_draw_string(uint8_t x, const uint8_t y, const char* str,
                         const bool on) {
    while (*str) {
        ssd1306_draw_char(x, y, *str, on);
        x += FONT_WIDTH;
        str++;
    }
}
